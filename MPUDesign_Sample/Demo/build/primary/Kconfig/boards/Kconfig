## MPUDesign_Sample/Demo/build/primary/Kconfig/boards/Kconfig
```kconfig
# Load Zephyr board Kconfig descriptions.
osource "/home/mahmoudelshazly89/Storage/zephyr/MPUDesign/westworkspace/deps/zephyr/boards/st/stm32f746g_disco/Kconfig"
```

## MPUDesign_Sample/Demo/build/primary/Kconfig/boards/Kconfig.defconfig
```kconfig
# Load Zephyr board defconfig descriptions.
osource "/home/mahmoudelshazly89/Storage/zephyr/MPUDesign/westworkspace/deps/zephyr/boards/st/stm32f746g_disco/Kconfig.defconfig"
```

## MPUDesign_Sample/Demo/build/primary/Kconfig/boards/Kconfig.stm32f746g_disco
```kconfig
# Load board Kconfig descriptions.
osource "/home/mahmoudelshazly89/Storage/zephyr/MPUDesign/westworkspace/deps/zephyr/boards/st/stm32f746g_disco/Kconfig.stm32f746g_disco"
```

## Samples/hello_world/build/primary/Kconfig/boards/Kconfig.stm32h747i_disco
```kconfig
# Load board Kconfig descriptions.
osource "/home/mahmoudelshazly89/Storage/zephyr/westworkspace/deps/zephyr/boards/st/stm32h747i_disco/Kconfig.stm32h747i_disco"
```

## Samples/hello_world/build/primary/Kconfig/boards/Kconfig.sysbuild
```kconfig
# Load Sysbuild board Kconfig descriptions.
osource "/home/mahmoudelshazly89/Storage/zephyr/westworkspace/deps/zephyr/boards/st/stm32h747i_disco/Kconfig.sysbuild"
```

## UserSpacePartitions/build/primary/Kconfig/boards/Kconfig
```kconfig
# Load Zephyr board Kconfig descriptions.
osource "/home/mahmoudelshazly89/Storage/zephyr/westworkspace/deps/zephyr/boards/st/stm32f746g_disco/Kconfig"
```

## helloworld_user/hello_world_user/build/primary/Kconfig/Kconfig.modules
```kconfig
menu "cmsis (/home/mahmoudelshazly89/Storage/zephyr/westworkspace/deps/modules/hal/cmsis)"
osource "$(ZEPHYR_CMSIS_KCONFIG)"
config ZEPHYR_CMSIS_MODULE
	bool
	default y
endmenu
menu "cmsis-dsp (/home/mahmoudelshazly89/Storage/zephyr/westworkspace/deps/modules/lib/cmsis-dsp)"
osource "$(ZEPHYR_CMSIS_DSP_KCONFIG)"
config ZEPHYR_CMSIS_DSP_MODULE
	bool
	default y
endmenu
menu "cmsis_6 (/home/mahmoudelshazly89/Storage/zephyr/westworkspace/deps/modules/hal/cmsis_6)"
osource "$(ZEPHYR_CMSIS_6_KCONFIG)"
config ZEPHYR_CMSIS_6_MODULE
	bool
	default y
endmenu
config ZEPHYR_HAL_STM32_MODULE
	bool
	default y

config ZEPHYR_HAL_STM32_MODULE_BLOBS
	bool
config ZEPHYR_MCUBOOT_MODULE
	bool
	default y
menu "percepio (/home/mahmoudelshazly89/Storage/zephyr/westworkspace/deps/modules/debug/percepio)"
osource "/home/mahmoudelshazly89/Storage/zephyr/westworkspace/deps/modules/debug/percepio/zephyr/Kconfig"
config ZEPHYR_PERCEPIO_MODULE
	bool
	default y
endmenu
menu "picolibc (/home/mahmoudelshazly89/Storage/zephyr/westworkspace/deps/modules/lib/picolibc)"
osource "/home/mahmoudelshazly89/Storage/zephyr/westworkspace/deps/modules/lib/picolibc/zephyr/Kconfig"
config ZEPHYR_PICOLIBC_MODULE
	bool
	default y
endmenu
menu "segger (/home/mahmoudelshazly89/Storage/zephyr/westworkspace/deps/modules/debug/segger)"
osource "$(ZEPHYR_SEGGER_KCONFIG)"
config ZEPHYR_SEGGER_MODULE
	bool
	default y
endmenu
```

## helloworld_user/hello_world_user/build/primary/Kconfig/boards/Kconfig.stm32f746g_disco
```kconfig
# Load board Kconfig descriptions.
osource "/home/mahmoudelshazly89/Storage/zephyr/westworkspace/deps/zephyr/boards/st/stm32f746g_disco/Kconfig.stm32f746g_disco"
```

## user_mode_kernel_object/build/primary/Kconfig/arch/Kconfig
```kconfig
# Load Zephyr Arch Kconfig descriptions.
osource "/home/mahmoudelshazly89/Storage/zephyr/westworkspace/deps/zephyr/arch/rx/Kconfig"
osource "/home/mahmoudelshazly89/Storage/zephyr/westworkspace/deps/zephyr/arch/x86/Kconfig"
osource "/home/mahmoudelshazly89/Storage/zephyr/westworkspace/deps/zephyr/arch/xtensa/Kconfig"
osource "/home/mahmoudelshazly89/Storage/zephyr/westworkspace/deps/zephyr/arch/sparc/Kconfig"
osource "/home/mahmoudelshazly89/Storage/zephyr/westworkspace/deps/zephyr/arch/riscv/Kconfig"
osource "/home/mahmoudelshazly89/Storage/zephyr/westworkspace/deps/zephyr/arch/posix/Kconfig"
osource "/home/mahmoudelshazly89/Storage/zephyr/westworkspace/deps/zephyr/arch/mips/Kconfig"
osource "/home/mahmoudelshazly89/Storage/zephyr/westworkspace/deps/zephyr/arch/arm64/Kconfig"
osource "/home/mahmoudelshazly89/Storage/zephyr/westworkspace/deps/zephyr/arch/arm/Kconfig"
osource "/home/mahmoudelshazly89/Storage/zephyr/westworkspace/deps/zephyr/arch/arc/Kconfig"
```
